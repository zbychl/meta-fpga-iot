/*
 * TODO
 */

/dts-v1/;
#include "socfpga_cyclone5_de0_nano_soc.dts"

/ {
	aliases {
	};

	chosen {
	};

/*
 * Add GPIO configuration for Altera PIO IP.
 * Adjust Avalon MM address if needed.
 */
/*
	soc {
		gpio_altr0: gpio@ff210040 {
			compatible = "altr,pio-1.0";
			reg = <0xff210040 0x10>;
			altr,ngpio = <4>;
			#gpio-cells = <2>;
			gpio-controller;
			gpio-line-names = "FPGA_LED0","FPGA_LED1","FPGA_LED2","FPGA_LED3";
		};
	};
*/
};

