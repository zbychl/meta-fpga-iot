## conf/layer.conf
```bitbake
# We have a conf and classes directory, append to BBPATH
BBPATH .= ":${LAYERDIR}"

# We have a recipes directory, add to BBFILES
BBFILES += "${LAYERDIR}/recipes*/*/*.bb ${LAYERDIR}/recipes*/*/*.bbappend"

BBFILE_COLLECTIONS += "meta-fpga-iot"
BBFILE_PATTERN_meta-fpga-iot := "^${LAYERDIR}/"
# increase the number
BBFILE_PRIORITY_meta-fpga-iot = "11"
LAYERSERIES_COMPAT_meta-fpga-iot = "dunfell"

# yves
BBDEBUG = "yes"
```

## meta-a10soc-devkit/conf/bblayers.conf.sample
```bitbake
# LAYER_CONF_VERSION is increased each time build/conf/bblayers.conf
# changes incompatibly
LCONF_VERSION = "7"

BBPATH = "${TOPDIR}"
BBFILES ?= ""

BBLAYERS ?= " \
  ##OEROOT##/meta \
  ##OEROOT##/meta-poky \
  ##OEROOT##/meta-yocto-bsp \
  ##OEROOT##/../meta-openembedded/meta-oe \
  ##OEROOT##/../meta-openembedded/meta-networking \
  ##OEROOT##/../meta-openembedded/meta-webserver \
  ##OEROOT##/../meta-openembedded/meta-perl \
  ##OEROOT##/../meta-openembedded/meta-python \
  ##OEROOT##/../meta-intel-fpga \
  ##OEROOT##/../meta-fpga-iot \
  ##OEROOT##/../meta-fpga-iot/meta-common \
  ##OEROOT##/../meta-fpga-iot/meta-a10soc-devkit \
"
```

## meta-a10soc-devkit/conf/layer.conf
```bitbake
# We have a conf and classes directory, add to BBPATH
BBPATH .= ":${LAYERDIR}"

# We have recipes-* directories, add to BBFILES
BBFILES += "${LAYERDIR}/recipes-*/*/*.bb ${LAYERDIR}/recipes-*/*/*.bbappend"

BBFILE_COLLECTIONS += "meta-a10soc-devkit"
#BBFILE_PATTERN_meta-a10soc-devkit := "^${LAYERDIR}/"
BBFILE_PATTERN_meta-a10soc-devkit := "^${LAYERDIR}/"
BBFILE_PRIORITY_meta-a10soc-devkit = "12"

LAYERSERIES_COMPAT_meta-a10soc-devkit = "${LAYERSERIES_COMPAT_core}"
```

## meta-a10soc-devkit/conf/machine/a10soc-devkit.conf
```bitbake
require conf/machine/include/socfpga.inc

SPL_BINARY = "spl/u-boot-splx4.sfp"
UBOOT_BINARY = "u-boot.img"

# TBD: check if required
PREFERRED_PROVIDER_virtual/bootloader = "u-boot-socfpga"
PREFERRED_VERSION_u-boot-socfpga ?= "v2022.04%"
# end of TBD

UBOOT_CONFIG ??= "arria10-socdk"
UBOOT_CONFIG[arria10-socdk] = "socfpga_arria10_defconfig"

KMACHINE = "arria10"

# Default kernel devicetrees
KERNEL_DEVICETREE ?= "\
			a10soc-devkit.dtb \
			"

EXTRA_IMAGECMD:jffs2 ?= "-n -q \
	${@bb.utils.contains("IMAGE_TYPE", "nand", "-e 0x20000 -s 0x200", "", d)} \
	${@bb.utils.contains("IMAGE_TYPE", "qspi", "-e 0x10000", "", d)} \
	"

SERIAL_CONSOLES ?= "115200;ttyS0"

UBOOT_EXTLINUX ?= "1"
UBOOT_EXTLINUX_LABELS ?= "default"
UBOOT_EXTLINUX_DEFAULT_LABEL ?= "Arria10 SOCDK SDMMC"

UBOOT_EXTLINUX_MENU_DESCRIPTION:default ?= "Arria10 SOCDK SDMMC"
UBOOT_EXTLINUX_KERNEL_IMAGE:default ?= "../${KERNEL_IMAGETYPE}"
UBOOT_EXTLINUX_FDTDIR:default ?= ".."
UBOOT_EXTLINUX_CONSOLE ?= "console=ttyS0,115200n8"
UBOOT_EXTLINUX_KERNEL_ARGS:default ?= "rootwait rw earlyprintk memmap=16M$0x3F000000"
UBOOT_EXTLINUX_ROOT:default ?= "root=/dev/mmcblk0p2"

IMAGE_BOOT_FILES ?= " \
	${KERNEL_DEVICETREE} \
	${KERNEL_IMAGETYPE} \
	${UBOOT_BINARY} \
	extlinux.conf;extlinux/extlinux.conf \
        "

# Build both Image and zImage for Arria10
KERNEL_ALT_IMAGETYPE = "Image"

WKS_FILE ?= "sdimage-fpga-iot-a10soc-devkit.wks"
IMAGE_FSTYPES:append = " wic"

PREFERRED_PROVIDER_virtual/kernel = "linux-socfpga-lts"
PREFERRED_VERSION_linux-socfpga-lts ?= "5.15%"
```

## meta-common/conf/layer.conf
```bitbake
# We have a conf and classes directory, add to BBPATH
BBPATH .= ":${LAYERDIR}"

# We have recipes-* directories, add to BBFILES
BBFILES += "${LAYERDIR}/recipes*/*/*.bb \ 
	    ${LAYERDIR}/recipes*/*/*.bbappend"

BBFILE_COLLECTIONS += "meta-common"
BBFILE_PATTERN_meta-common = ""
BBFILE_PRIORITY_meta-common = "11"

LAYERSERIES_COMPAT_meta-common = "kirkstone"
```

## meta-de0-nano/conf/bblayers.conf.sample
```bitbake
# LAYER_CONF_VERSION is increased each time build/conf/bblayers.conf
# changes incompatibly
LCONF_VERSION = "7"

BBPATH = "${TOPDIR}"
BBFILES ?= ""

BBLAYERS ?= " \
  ##OEROOT##/meta \
  ##OEROOT##/meta-poky \
  ##OEROOT##/meta-yocto-bsp \
  ##OEROOT##/../meta-openembedded/meta-oe \
  ##OEROOT##/../meta-openembedded/meta-networking \
  ##OEROOT##/../meta-openembedded/meta-perl \
  ##OEROOT##/../meta-openembedded/meta-python \
  ##OEROOT##/../meta-altera \
  ##OEROOT##/../meta-fpga-iot \
  ##OEROOT##/../meta-fpga-iot/meta-common \
  ##OEROOT##/../meta-fpga-iot/meta-de0-nano \
"
```

## meta-de0-nano/conf/layer.conf
```bitbake
# We have a conf and classes directory, add to BBPATH
BBPATH .= ":${LAYERDIR}"

# We have recipes-* directories, add to BBFILES
BBFILES += "${LAYERDIR}/recipes-*/*/*.bb ${LAYERDIR}/recipes-*/*/*.bbappend"

BBFILE_COLLECTIONS += "meta-de0-nano"
#BBFILE_PATTERN_meta-de0-nano := "^${LAYERDIR}/"
BBFILE_PATTERN_meta-de0-nano := "^${LAYERDIR}/"
BBFILE_PRIORITY_meta-de0-nano = "12"

LAYERSERIES_COMPAT_meta-de0-nano = "${LAYERSERIES_COMPAT_core}"
```

## meta-de0-nano/conf/local.conf.sample
```bitbake
# Where to place downloads
#DL_DIR ?= "${HOME}/yocto-temp/downloads"

# Where to place shared-state files
#SSTATE_DIR ?= "${HOME}/yocto-temp/sstate-cache"

DISTRO = "poky"

# Package Management configuration
PACKAGE_CLASSES ?= "package_rpm"

SANITY_TESTED_DISTROS_append ?= " RedHatEnterpriseWorkstation-6.*"

#EXTRA_IMAGE_FEATURES = "debug-tweaks"
#USER_CLASSES ?= "buildstats image-mklibs image-prelink"

PATCHRESOLVE = "noop"

# Disk Space Monitoring during the build
BB_DISKMON_DIRS = "\
    STOPTASKS,${TMPDIR},1G,100K \
    STOPTASKS,${DL_DIR},1G,100K \
    STOPTASKS,${SSTATE_DIR},1G,100K \
    STOPTASKS,/tmp,100M,100K \
    ABORT,${TMPDIR},100M,1K \
    ABORT,${DL_DIR},100M,1K \
    ABORT,${SSTATE_DIR},100M,1K \
    ABORT,/tmp,10M,1K"

PACKAGECONFIG_append_pn-qemu-native = " sdl"
PACKAGECONFIG_append_pn-nativesdk-qemu = " sdl"
#ASSUME_PROVIDED += "libsdl-native"

CONF_VERSION = "1"

# Set the root password to 'fpgai0t'
INHERIT += "extrausers"
# To generate the password hash run: mkpasswd -m sha-512 fpgai0t -s "11223344"
EXTRA_USERS_PARAMS = " \
  usermod -p '\$6\$11223344\$VIywnBJNxOjsWY7SweEjH0T3zJlSpIssk3xxMMUpg.XKLcGazn0/7iGDXP7d6wyVyLi0u/ziD/0ALWv4DblFs/' root; \
"

MACHINE ??= "de0-nano"

# dbus-sensors uses CMake downloads for package manager.
# Exports below provide the proxy variables to all recipes:
export http_proxy
export HTTP_PROXY
export https_proxy
export HTTPS_PROXY
export no_proxy
export NO_PROXY

#
# Use systemd for system initialization
#
DISTRO_FEATURES_append = " systemd"
DISTRO_FEATURES_BACKFILL_CONSIDERED += "sysvinit"
VIRTUAL-RUNTIME_init_manager = "systemd"
VIRTUAL-RUNTIME_initscripts = "systemd-compat-units"
```

## meta-de0-nano/conf/machine/de0-nano.conf
```bitbake
require conf/machine/include/socfpga.inc

PREFERRED_PROVIDER_virtual/bootloader = "u-boot-socfpga"
PREFERRED_VERSION_u-boot-socfpga ?= "v2022.04%"

UBOOT_CONFIG ??= "de0-nano-soc"

UBOOT_CONFIG[de0-nano-soc] = "socfpga_de0_nano_soc_defconfig"

KMACHINE = "cyclone5"

# Default kernel devicetrees
KERNEL_DEVICETREE:de0-nano  ?= "\
                        de0-nano.dtb \
                        "

SERIAL_CONSOLES ?= "115200;ttyS0"

UBOOT_EXTLINUX ?= "1"
UBOOT_EXTLINUX_LABELS ?= "default"
UBOOT_EXTLINUX_DEFAULT_LABEL ?= "Cyclone5 SOCDK SDMMC"

UBOOT_EXTLINUX_FDT:default ?= "../de0-nano.dtb"
UBOOT_EXTLINUX_ROOT:default ?= "root=/dev/mmcblk0p3"
UBOOT_EXTLINUX_MENU_DESCRIPTION:default ?= "Cyclone5 SOCDK SDMMC"
UBOOT_EXTLINUX_KERNEL_IMAGE:default ?= "../${KERNEL_IMAGETYPE}"
UBOOT_EXTLINUX_FDTDIR:default ?= "../"
UBOOT_EXTLINUX_KERNEL_ARGS:default ?= "rootwait rw earlycon"

IMAGE_BOOT_FILES ?= " \
        ${KERNEL_DEVICETREE} \
        ${KERNEL_IMAGETYPE} \
        extlinux.conf;extlinux/extlinux.conf \
        "

WKS_FILE ?= "sdimage-fpga-iot-de0-nano.wks"
IMAGE_FSTYPES +="wic"

PREFERRED_PROVIDER_virtual/kernel = "linux-socfpga-lts"
PREFERRED_VERSION_linux-socfpga-lts ?= "5.15%"
```
